## dts/bindings/i2c/lowrisc,opentitan-i2c.yaml
```yaml
# Copyright (c) 2023 Rivos Inc.
# SPDX-License-Identifier: Apache-2.0

description: OpenTitan I2C controller

compatible: "lowrisc,opentitan-i2c"

include: i2c-controller.yaml

properties:
  reg:
    required: true
```
